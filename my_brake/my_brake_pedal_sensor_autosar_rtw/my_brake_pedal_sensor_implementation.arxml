AUTOSAR XML (schema 00051)
package /Company/Components
  swc implementation AccelerationPed_e942f831adb17bf2: programming-language=C, sw-version=9.3.1, used-code-generator=Embedded Coder 24.1 (R2024a) 19-Nov-2023, vendor-id=0, behavior=AccelerationPedalPositionSensor_InternalBehavior
    code-descriptors:
      code Code
        artifact-descriptors:
          short-label=my_brake_pedal_sensor_c, category=SWSRC
          short-label=my_brake_pedal_sensor_h, category=SWHDR
          short-label=my_brake_pedal_sensor_private_h, category=SWHDR
          short-label=my_brake_pedal_sensor_types_h, category=SWHDR
    resource consumption RsrcCons_my_brake_pedal_sensor
