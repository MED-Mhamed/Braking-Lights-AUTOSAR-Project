AUTOSAR XML (schema 00051)
standard types defined: float32, uint16, sint16
package /DataTypes
  impl type MyStruct_Actuator: category=STRUCTURE
    element BP1: implementation-data-type=rt_Array_float32_21
    element Table: implementation-data-type=rt_Array_SInt16_21
  impl type rt_Array_float32_21: category=ARRAY
    element rt_Array_float32_21: array-size=21, array-size-semantics=FIXED-SIZE, implementation-data-type=float32
  impl type rt_Array_SInt16_21: category=ARRAY
    element rt_Array_SInt16_21: array-size=21, array-size-semantics=FIXED-SIZE, implementation-data-type=sint16
package /DataTypes/ApplDataTypes
  app type Appl_HBridgeCmd_LkupTbl: category=CURVE, sw-calibration-access=READ-WRITE, sw-calprm-axis-set={sw-axis-index=1, category=STD_AXIS, sw-axis-individual={input-variable-type=float32, compu {identical}, sw-max-axis-points=21, sw-min-axis-points=21, range phys -INF..INF}}, compu {identical}, range phys -32768..32767, sw-record-layout=IntCur_f32_s16_M, value-axis-data-type=sint16
  app type sint16: category=VALUE, sw-calibration-access=READ-WRITE, compu {identical}, range phys -32768..32767
  app type float32: category=VALUE, sw-calibration-access=READ-WRITE, compu {identical}, range phys -INF..INF
package /DataTypes/Constants
  constant specification HBridgeCmd_LkupTbl: value-spec=[-2048 -1843 -1638 -1434 -1229 -1024 -819 -614 -410 -205 0 205 410 614 819 1024 1229 1434 1638 1843 2048] over axis [-100 -90 -80 -70 -60 -50 -40 -30 -20 -10 0 10 20 30 40 50 60 70 80 90 100]
package /DataTypes/DataTypeMappings
  data type mapping set ThrottlePositionActuatorDataTypeMappingsSet
    data-type-maps:
      application-data-type=Appl_HBridgeCmd_LkupTbl, implementation-data-type=MyStruct_Actuator
      application-data-type=sint16, implementation-data-type=sint16
      application-data-type=float32, implementation-data-type=float32
package /DataTypes/SwRecordLayouts
  sw record layout IntCur_f32_s16
  sw record layout IntCur_f32_s16_M: sw-record-layout-group={short-label=IntCur_f32_s16_M, sw-record-layout-group={short-label=X, category=INDEX_INCR, sw-record-layout-group-axis=1, sw-record-layout-group-index=X, sw-record-layout-group-from=1, sw-record-layout-group-to=-1, sw-record-layout-v={short-label=VALUE, base-type=float32, sw-record-layout-v-axis=1, sw-record-layout-v-prop=VALUE}}, sw-record-layout-group={short-label=Val, category=COLUMN_DIR, sw-record-layout-group-axis=1, sw-record-layout-group-index=X, sw-record-layout-group-from=1, sw-record-layout-group-to=-1, sw-record-layout-v={short-label=Val, base-type=sint16, sw-record-layout-v-axis=0, sw-record-layout-v-prop=VALUE, sw-record-layout-v-index=X}}}
package /DataTypes/Units
  unit NoUnit: factor-si-to-unit=1, offset-si-to-unit=0
