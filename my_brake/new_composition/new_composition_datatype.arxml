AUTOSAR XML (schema 00051)
standard types defined: float32, uint16, sint16
package /DataTypes
  5 x impl type:
    MyStruct_Actuator: category=STRUCTURE
      element BP1: implementation-data-type=rt_Array_float32_21
      element Table: implementation-data-type=rt_Array_SInt16_21
    rt_Array_float32_21: category=ARRAY
      element rt_Array_float32_21: array-size=21, array-size-semantics=FIXED-SIZE, implementation-data-type=float32
    rt_Array_SInt16_21: category=ARRAY
      element rt_Array_SInt16_21: array-size=21, array-size-semantics=FIXED-SIZE, implementation-data-type=sint16
    MyStruct: category=STRUCTURE
      element BP1: implementation-data-type=rt_Array_float32_11
      element Table: implementation-data-type=rt_Array_float32_11
    rt_Array_float32_11: category=ARRAY
      element rt_Array_float32_11: array-size=11, array-size-semantics=FIXED-SIZE, implementation-data-type=float32
package /DataTypes/ApplDataTypes
  5 x app type, all with sw-calibration-access=READ-WRITE, compu {identical}:
    Appl_HBridgeCmd_LkupTbl: category=CURVE, sw-calprm-axis-set={sw-axis-index=1, category=STD_AXIS, sw-axis-individual={input-variable-type=float32, compu {identical}, sw-max-axis-points=21, sw-min-axis-points=21, range phys -INF..INF}}, range phys -32768..32767, sw-record-layout=IntCur_f32_s16_M, value-axis-data-type=sint16
    sint16: category=VALUE, range phys -32768..32767
    float32: category=VALUE, range phys -INF..INF
    Appl_SetpointPercent_LkupTbl: category=CURVE, sw-calprm-axis-set={sw-axis-index=1, category=STD_AXIS, sw-axis-individual={input-variable-type=float32, compu {identical}, sw-max-axis-points=11, sw-min-axis-points=11, range phys -INF..INF}}, range phys -INF..INF, sw-record-layout=IntCur_f32_f32_M, value-axis-data-type=float32
    Appl_TPSPercent_LkupTbl: category=CURVE, sw-calprm-axis-set={sw-axis-index=1, category=STD_AXIS, sw-axis-individual={input-variable-type=float32, compu {identical}, sw-max-axis-points=11, sw-min-axis-points=11, range phys -INF..INF}}, range phys -INF..INF, sw-record-layout=IntCur_f32_f32_M, value-axis-data-type=float32
package /DataTypes/Constants
  constant specification HBridgeCmd_LkupTbl: value-spec=[-2048 -1843 -1638 -1434 -1229 -1024 -819 -614 -410 -205 0 205 410 614 819 1024 1229 1434 1638 1843 2048] over axis [-100 -90 -80 -70 -60 -50 -40 -30 -20 -10 0 10 20 30 40 50 60 70 80 90 100]
  constant specification SetpointPercent_LkupTbl: value-spec=[0 10 20 30 40 50 60 70 80 90 100] over axis [170 251.5 333 414.5 496 577.5 659 740.5 822 903.5 985]
  constant specification TPSPercent_LkupTbl: value-spec=[0 10 20 30 40 50 60 70 80 90 100] over axis [170 249.60000610351562 329.20001220703125 408.79998779296875 488.3999938964844 568 647.5999755859375 727.2000122070312 806.7999877929688 886.4000244140625 966]
package /DataTypes/DataTypeMappings
  data type mapping set ThrottlePositionActuatorDataTypeMappingsSet
    data-type-maps:
      application-data-type=Appl_HBridgeCmd_LkupTbl, implementation-data-type=MyStruct_Actuator
      application-data-type=sint16, implementation-data-type=sint16
      application-data-type=float32, implementation-data-type=float32
  data type mapping set AccelerationPedalPositionSensorDataTypeMappingsSet
    data-type-maps:
      application-data-type=Appl_SetpointPercent_LkupTbl, implementation-data-type=MyStruct
      application-data-type=float32, implementation-data-type=float32
  data type mapping set ThrottlePositionSensorDataTypeMappingsSet
    data-type-maps:
      application-data-type=Appl_TPSPercent_LkupTbl, implementation-data-type=MyStruct
      application-data-type=float32, implementation-data-type=float32
package /DataTypes/SwRecordLayouts
  4 x sw record layout:
    IntCur_f32_s16_M: sw-record-layout-group={short-label=IntCur_f32_s16_M, sw-record-layout-group={short-label=X, category=INDEX_INCR, sw-record-layout-group-axis=1, sw-record-layout-group-index=X, sw-record-layout-group-from=1, sw-record-layout-group-to=-1, sw-record-layout-v={short-label=VALUE, base-type=float32, sw-record-layout-v-axis=1, sw-record-layout-v-prop=VALUE}}, sw-record-layout-group={short-label=Val, category=COLUMN_DIR, sw-record-layout-group-axis=1, sw-record-layout-group-index=X, sw-record-layout-group-from=1, sw-record-layout-group-to=-1, sw-record-layout-v={short-label=Val, base-type=sint16, sw-record-layout-v-axis=0, sw-record-layout-v-prop=VALUE, sw-record-layout-v-index=X}}}
    IntCur_f32_s16
    IntCur_f32_f32_M: sw-record-layout-group={short-label=IntCur_f32_f32_M, sw-record-layout-group={short-label=X, category=INDEX_INCR, sw-record-layout-group-axis=1, sw-record-layout-group-index=X, sw-record-layout-group-from=1, sw-record-layout-group-to=-1, sw-record-layout-v={short-label=VALUE, base-type=float32, sw-record-layout-v-axis=1, sw-record-layout-v-prop=VALUE}}, sw-record-layout-group={short-label=Val, category=COLUMN_DIR, sw-record-layout-group-axis=1, sw-record-layout-group-index=X, sw-record-layout-group-from=1, sw-record-layout-group-to=-1, sw-record-layout-v={short-label=Val, base-type=float32, sw-record-layout-v-axis=0, sw-record-layout-v-prop=VALUE, sw-record-layout-v-index=X}}}
    IntCur_f32_f32
package /DataTypes/Units
  unit NoUnit: factor-si-to-unit=1, offset-si-to-unit=0
