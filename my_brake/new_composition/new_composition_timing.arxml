AUTOSAR XML (schema 00051)
package /Timing
  vfb timing new_composition_timing: component=new_composition
    timing-requirements:
      execution order constraint EOC: base-composition=new_composition
        ordered-elements:
          4 x eoc executable entity ref, all with executable=Runnable_Step:
            Actuator_Runnable_Step: component=Actuator, successor=Controller_Runnable_Step
            Controller_Runnable_Step: component=Controller, successor=Pedal_sensor_Runnable_Step
            Pedal_sensor_Runnable_Step: component=Pedal_sensor, successor=Throttle_sensor_Runnable_Step
            Throttle_sensor_Runnable_Step: component=Throttle_sensor
