AUTOSAR XML (schema 00051)
standard types defined: float32, uint16
package /DataTypes
  impl type MyStruct: category=STRUCTURE
    element BP1: implementation-data-type=rt_Array_float32_11
    element Table: implementation-data-type=rt_Array_float32_11
  impl type rt_Array_float32_11: category=ARRAY
    element rt_Array_float32_11: array-size=11, array-size-semantics=FIXED-SIZE, implementation-data-type=float32
package /DataTypes/ApplDataTypes
  app type Appl_TPSPercent_LkupTbl: category=CURVE, sw-calibration-access=READ-WRITE, sw-calprm-axis-set={sw-axis-index=1, category=STD_AXIS, sw-axis-individual={input-variable-type=float32, compu {identical}, sw-max-axis-points=11, sw-min-axis-points=11, range phys -INF..INF}}, compu {identical}, range phys -INF..INF, sw-record-layout=IntCur_f32_f32_M, value-axis-data-type=float32
  app type float32: category=VALUE, sw-calibration-access=READ-WRITE, compu {identical}, range phys -INF..INF
package /DataTypes/Constants
  constant specification TPSPercent_LkupTbl: value-spec=[0 10 20 30 40 50 60 70 80 90 100] over axis [170 249.60000610351562 329.20001220703125 408.79998779296875 488.3999938964844 568 647.5999755859375 727.2000122070312 806.7999877929688 886.4000244140625 966]
package /DataTypes/DataTypeMappings
  data type mapping set ThrottlePositionSensorDataTypeMappingsSet
    data-type-maps:
      application-data-type=Appl_TPSPercent_LkupTbl, implementation-data-type=MyStruct
      application-data-type=float32, implementation-data-type=float32
package /DataTypes/SwRecordLayouts
  sw record layout IntCur_f32_f32
  sw record layout IntCur_f32_f32_M: sw-record-layout-group={short-label=IntCur_f32_f32_M, sw-record-layout-group={short-label=X, category=INDEX_INCR, sw-record-layout-group-axis=1, sw-record-layout-group-index=X, sw-record-layout-group-from=1, sw-record-layout-group-to=-1, sw-record-layout-v={short-label=VALUE, base-type=float32, sw-record-layout-v-axis=1, sw-record-layout-v-prop=VALUE}}, sw-record-layout-group={short-label=Val, category=COLUMN_DIR, sw-record-layout-group-axis=1, sw-record-layout-group-index=X, sw-record-layout-group-from=1, sw-record-layout-group-to=-1, sw-record-layout-v={short-label=Val, base-type=float32, sw-record-layout-v-axis=0, sw-record-layout-v-prop=VALUE, sw-record-layout-v-index=X}}}
package /DataTypes/Units
  unit NoUnit: factor-si-to-unit=1, offset-si-to-unit=0
