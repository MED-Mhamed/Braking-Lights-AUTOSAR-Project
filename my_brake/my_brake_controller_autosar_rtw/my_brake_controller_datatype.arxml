AUTOSAR XML (schema 00051)
standard types defined: float32, uint16
